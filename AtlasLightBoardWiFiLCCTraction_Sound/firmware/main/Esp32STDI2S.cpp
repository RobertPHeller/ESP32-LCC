// -!- C++ -!- //////////////////////////////////////////////////////////////
//
//  System        : 
//  Module        : 
//  Object Name   : $RCSfile$
//  Revision      : $Revision$
//  Date          : $Date$
//  Author        : $Author$
//  Created By    : Robert Heller
//  Created       : Mon Aug 17 18:27:33 2026
//  Last Modified : <260820.1426>
//
//  Description	
//
//  Notes
//
//  History
//	
/////////////////////////////////////////////////////////////////////////////
//
//    Copyright (C) 2026  Robert Heller D/B/A Deepwoods Software
//			51 Locke Hill Road
//			Wendell, MA 01379-9728
//
//    This program is free software; you can redistribute it and/or modify
//    it under the terms of the GNU General Public License as published by
//    the Free Software Foundation; either version 2 of the License, or
//    (at your option) any later version.
//
//    This program is distributed in the hope that it will be useful,
//    but WITHOUT ANY WARRANTY; without even the implied warranty of
//    MERCHANTABILITY or FITNESS FOR A PARTICULAR PURPOSE.  See the
//    GNU General Public License for more details.
//
//    You should have received a copy of the GNU General Public License
//    along with this program; if not, write to the Free Software
//    Foundation, Inc., 675 Mass Ave, Cambridge, MA 02139, USA.
//
// 
//
//////////////////////////////////////////////////////////////////////////////

static const char rcsid[] = "@(#) : $Id$";

#include "driver/i2s_std.h"
#include "driver/gpio.h"
#include "esp_check.h"
#include <hal/gpio_types.h>
#include <utils/Atomic.hxx>
#include <unistd.h>
#include <vector>
#include "stropts.h"
#include "Esp32STDI2S.hxx"
#include "sdkconfig.h"
#include "utils/format_utils.hxx"
#include "utils/logging.h"
#include "utils/StringPrintf.hxx"

#include <algorithm>

#if CONFIG_VFS_SUPPORT_TERMIOS
// remove defines added by arduino-esp32 core/esp32/binary.h which are
// duplicated in sys/termios.h which may be included by esp_vfs.h
#undef B110
#undef B1000000
#endif // CONFIG_VFS_SUPPORT_TERMIOS
#include <esp_vfs.h>
#include <string>
#include <sys/errno.h>

namespace openmrn_esp32
{
Esp32STDI2S::Esp32STDI2S(const char * const path)
      : path_(path)
{
}

Esp32STDI2S::~Esp32STDI2S()
{
    for (size_t idx = 0; idx < SOC_I2S_NUM; idx++)
    {
        if (i2sInitialized_[idx])
        {
            // delete I2S driver (?)
        }
    }
    if (vfsInitialized_)
    {
        ESP_ERROR_CHECK(esp_vfs_unregister(path_));
    }
}

void Esp32STDI2S::hw_init(const gpio_num_t bclk, const gpio_num_t dout,
                          const gpio_num_t ws, 
                          uint32_t sample_rate_hz, i2s_port_t port)
{
    if (!i2sInitialized_[port])
    {
        /* Setp 1: Determine the I2S channel configuration and allocate both channels
         * The default configuration can be generated by the helper macro,
         * it only requires the I2S controller id and I2S role */
        i2s_chan_config_t chan_cfg = I2S_CHANNEL_DEFAULT_CONFIG(port, I2S_ROLE_MASTER);
        ESP_ERROR_CHECK(i2s_new_channel(&chan_cfg, &i2s_tx_chans_[port], 
                                        &i2s_rx_chans_[port]));
        
        /* Step 2: Setting the configurations of standard mode, and initialize rx & tx channels
         * The slot configuration and clock configuration can be generated by the macros
         * These two helper macros is defined in 'i2s_std.h' which can only be used in STD mode.
         * They can help to specify the slot and clock configurations for initialization or re-configuring */
        i2s_std_config_t std_cfg = {
            .clk_cfg  = I2S_STD_CLK_DEFAULT_CONFIG(44100),
            .slot_cfg = I2S_STD_MSB_SLOT_DEFAULT_CONFIG(I2S_DATA_BIT_WIDTH_16BIT, 
                                                        I2S_SLOT_MODE_MONO),
            .gpio_cfg = {
                .mclk = I2S_GPIO_UNUSED,    // some codecs may require mclk signal, this example doesn't need it
                .bclk = bclk,
                .ws   = ws,
                .dout = dout,
                .din  = dout, // In duplex mode, bind output and input to a same gpio can loopback internally
                .invert_flags = {
                    .mclk_inv = false,
                    .bclk_inv = false,
                    .ws_inv   = false,
                },
            },
        };
        /* Initialize the channels */
        ESP_ERROR_CHECK(i2s_channel_init_std_mode(i2s_tx_chans_[port], 
                                                  &std_cfg));
        ESP_ERROR_CHECK(i2s_channel_init_std_mode(i2s_rx_chans_[port], 
                                                  &std_cfg));
    }
    else
    {
        LOG_ERROR("[I2S] I2S%d has already been initialized!", port);
    }
    if (!vfsInitialized_)
    {
        esp_vfs_t vfs = {};
        vfs.write_p = vfs_write_;
        vfs.read_p = vfs_read_;
        vfs.open_p = vfs_open_;
        vfs.close_p = vfs_close_;
        vfs.fcntl_p = vfs_fcntl_;
        vfs.ioctl_p = vfs_ioctl_;
        vfs.flags = ESP_VFS_FLAG_CONTEXT_PTR;
        ESP_ERROR_CHECK(esp_vfs_register(path_, &vfs, this));
        
        vfsInitialized_ = true;
    }
    
}
ssize_t Esp32STDI2S::write(int fd, const void *buf, size_t size)
{
    i2s_port_t port;
    {
        AtomicHolder h(this);
        
        auto entry = std::find_if(devices_.begin(), devices_.end(),
                                  [fd](const auto &device)
                              {
                                  return device.fd == fd;
                              });
        if (entry == devices_.end())
        {
            // file handle not found, return an error.
            errno = EBADF;
            return -EBADF;
        }
        else if (entry->fd < 0)
        {
            // no address has been defined for this file handle, return an error
            errno = EINVAL;
            return -EINVAL;
        }
        port = entry->port;
    }
    size_t w_bytes = 0;
    if (i2s_channel_write(i2s_tx_chans_[port],buf,size,&w_bytes,1000) != ESP_OK)
    {
        errno = EIO;
        return -EIO;
    }
    else
    {
        return w_bytes;
    }
}

ssize_t Esp32STDI2S::read(int fd, void *buf, size_t size)
{
    i2s_port_t port;
    {
        AtomicHolder h(this);
        
        auto entry = std::find_if(devices_.begin(), devices_.end(),
                                  [fd](const auto &device)
                              {
                                  return device.fd == fd;
                              });
        if (entry == devices_.end())
        {
            // file handle not found, return an error.
            errno = EBADF;
            return -EBADF;
        }
        else if (entry->fd < 0)
        {
            // no address has been defined for this file handle, return an error
            errno = EINVAL;
            return -EINVAL;
        }
        port = entry->port;
    }
    size_t r_bytes = 0;
    if (i2s_channel_read(i2s_rx_chans_[port], buf, size, &r_bytes, 1000) == ESP_OK)
    {
        return r_bytes;
    }
    else
    {
        errno = EIO;
        return -EIO;
    }
}
    
        
int Esp32STDI2S::open(const char *path, int flags, int mode)
{
    std::string path_str = path;
    i2s_device_t new_dev =
    {
        .port = I2S_NUM_0,
        .fd = 0,
    };
    if (path_str.back() == '0')
    {
        new_dev.port = I2S_NUM_0;
    }
#if SOC_I2S_NUM > 1
    else if (path_str.back() == '1')
    {
        new_dev.port = I2S_NUM_1;
    }
#endif // SOC_I2C_NUM > 1
    else
    {
        LOG_ERROR("[I2S] Unsupported I2S path: %s", path);
        errno = ENOENT;
        return -ENOENT;
    }
    if (!i2sInitialized_[new_dev.port])
    {
        LOG_ERROR("[I2S] Uninitialized I2S path: %s", path);
        errno = ENODEV;
        return -ENODEV;
    }
    // scan existing devices to find a unique file handle number to return to
    // the caller. The file handle starts with zero and is set to the maximum
    // file handle found plus one. When a file handle is reclaimed there will
    // be gaps in the file handles which will not be reclaimed until entries
    // with higher file handle numbers are also reclaimed.
    {
        AtomicHolder h(this);
        
        if (!devices_.empty())
        {
            for (auto &entry: devices_)
            {
                if (entry.fd >= new_dev.fd)
                {
                    new_dev.fd = entry.fd + 1;
                }
            }
        }
        devices_.push_back(new_dev);
    }
    
    LOG(INFO, "[I2S] Using fd: %d (I2S%d) for %s", new_dev.fd, new_dev.port,
        path);
    return new_dev.fd;
}

int Esp32STDI2S::close(int fd)
{
    AtomicHolder h(this);
    auto entry = std::find_if(devices_.begin(), devices_.end(),
    [fd](const auto &device)
    {
        return device.fd == fd;
    });
    
    // only delete the device if has been found.
    if (entry != devices_.end())
    {
        devices_.erase(entry);
    }
    
    return 0;
}


}
